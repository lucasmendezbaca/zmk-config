/*
 * macros.dtsi
 * Definiciones de macros personalizados para ZMK keymap
 */

 / {
    macros {
        compatible = "zmk,behavior-macros";

        macro_at: macro_at {
            compatible = "zmk,behavior-macro";
            label = "@";
            #binding-cells = <0>;
            behavior-cells = <1>;
        };

        macro_pipe: macro_pipe {
            compatible = "zmk,behavior-macro";
            label = "|";
            #binding-cells = <0>;
            behavior-cells = <1>;
        };
    };
};
