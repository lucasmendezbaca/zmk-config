/ {
    behaviors {
        unicode_map_behavior: unicode_map_behavior {
            compatible = "zmk,behavior-unicode-map";  // Especifica el tipo de comportamiento
            #binding-cells = <1>;                      // Indica que este nodo tiene 1 celda de vinculación

            bindings = <
                &unicode_map_entry UNICODE_N_TILDE 0x00F1 // ñ
                &unicode_map_entry UNICODE_DQUOTE 0x0022 // "
            >;
        };
    };
};
